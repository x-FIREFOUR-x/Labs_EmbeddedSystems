.nolist ; директива відключає генерацію коду у лістинг
; тобто далі у файлі *.lss не буде фіксуватися асемблерний код

.include "m8515def.inc" ; підключення стандартного заголовочного файлу для ATmega8

.list ; директива включає генерацію коду у лістинг
; тобто далі у файлі *.lss буде фіксуватися асемблерний код

.equ fCK = 8000000 ; частота в герцах
.equ BAUD = 9600 ; швидкість для УСАПП у бодах
.equ UBRR_value = (fCK/(BAUD*16))-1 ; розрахунок значення для регістра UBRR

.cseg ; директива визначення, що далі іде код програми
.org 0 ; директива визначення, що код програми у FLASH буде розміщено з нульової адреси

; КОД ОСНОВНОЇ ПРОГРАМИ
Start:
    rcall init_USART    ; (блок 1) відносний виклик підпрограми ініціалізації

    ; налаштування порту С на передачу
    LDI R16, 0xFF      ; (блок 2) R16 <- 0xFF
    OUT DDRC, R16      ; (блок 2) DDRC <- R16

    ; отримання того, що відправив віртуальний термінал
    rcall USART_recieve ; (блок 3) відносний виклик підпрограми USART_recieve

    ; виведення отриманого від терміналу символу на світлодіоди
    OUT PORTC, R16     ; (блок 4) PORTC <- R16

    ; налаштування порту А на прийом від кнопок
    LDI R16, 0x00      ; (блок 5) R16 <- 0x00
    OUT DDRA, R16      ; (блок 5) DDRA <- R16

    ; читання стану кнопок у регістр R16
    in R16, PINA       ; (блок 6) R16 <- PINA

    ; виведення отриманого від кнопок на світлодіоди
    OUT PORTC, R16     ; (блок 7) PORTC <- R16

    ; виведення стану кнопок на осцилограф та термінал
    rcall USART_send   ; (блок 8) відносний виклик підпрограми USART_send

; ПІДПРОГРАМА ІНІЦІАЛІЗАЦІЇ МОДУЛЯ USART
init_USART:
    ; програмування швидкості обміну 9600 бод
    ldi R16, high(UBRR_value)  ; (блок 1) R16 <- старший байт UBRR_value
    out UBRRH, R16              ; (блок 1) UBRRH <- R16
    ldi R16, low(UBRR_value)    ; (блок 1) R16 <- молодший байт UBRR_value
    out UBRRL, R16              ; (блок 1) UBRRL <- R16

    ; дозвіл роботи приймача-передавача модуля USART
    ldi R16, (1<<RXEN)|(1<<TXEN)
    out UCSRB, R16              ; (блок 1) UCSRB <- R16

    ; програмування передачі 8 біт з перевіркою на непарність
    ldi R16, (1<<URSEL)|(1<<UPM1)|(1<<UPM0)|(1<<UCSZ1)|(1<<UCSZ0)
    out UCSRC, R16              ; (блок 1) UCSRC <- R16
    ret                         ; (блок 1) повернення з підпрограми

; ПІДПРОГРАМА ПЕРЕДАЧІ ДАНИХ ЧЕРЕЗ USART
USART_send:
    out UDR, R16                ; (блок 8) регістр даних UDR <- R16
sending:
    sbis UCSRA, TXC             ; (блок 8) якщо TXC = 1, пропустити наступну команду
    rjmp sending                ; (блок 8) безумовний перехід на мітку sending
    ret                         ; (блок 8) повернення з підпрограми

; ПІДПРОГРАМА ПРИЙОМУ ДАНИХ ЧЕРЕЗ USART
USART_recieve:
    sbis UCSRA, RXC             ; (блок 3) якщо RXC = 1, пропустити наступну команду
    rjmp USART_recieve          ; (блок 3) безумовний перехід на мітку USART_recieve
    in R16, UDR                 ; (блок 3) R16 <- UDR (отриманий байт)
    ret                         ; (блок 3) повернення з підпрограми

